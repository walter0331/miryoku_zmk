## config/boards/shields/corne_dongle/Kconfig.defconfig
```kconfig
if SHIELD_CORNE_DONGLE

config ZMK_KEYBOARD_NAME
    default "Corne Dongle"

config ZMK_SPLIT
    default y

config ZMK_SPLIT_ROLE_CENTRAL
    default y

# both halves are peripherals now
config ZMK_SPLIT_BLE_CENTRAL_PERIPHERALS
    default 2

# host profiles + two peripherals
config BT_MAX_CONN
    default 7

config BT_MAX_PAIRED
    default 7

endif
```
